// SPDX-License-Identifier: GPL-2.0-only
/*
 * Copyright David Heidelberg <david@ixit.cz>
 */

/dts-v1/;

#include "msm8952-motorola-athene-common.dtsi"

/ {
	model = "Motorola Moto G4";
	compatible = "motorola,athene-13mp", "motorola,athene", "qcom,msm8952";

	qcom,board-id = <0x42 0x81a0>, <0x42 0x81ad>;
};
