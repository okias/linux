## Documentation/devicetree/bindings/arm/coresight-catu.yaml
```yaml
# SPDX-License-Identifier: GPL-2.0-only
%YAML 1.2
---
$id: http://devicetree.org/schemas/arm/coresight-catu.yaml#
$schema: http://devicetree.org/meta-schemas/core.yaml#

title: ARM Coresight Address Translation Unit device

maintainers:
  - Mike Leach <mike.leach@linaro.org>

allOf:
  - $ref: "coresight.yaml"

# Need a custom select here or 'arm,primecell' will match on lots of nodes
select:
  properties:
    compatible:
      contains:
        enum:
          - arm,coresight-catu
  required:
    - compatible

properties:
  $nodename:
    pattern: "^(etb|etf|etr)(@[0-9a-f]+)$"

  compatible:
    items:
      - const: arm,coresight-catu
      - const: arm,primecell

  reg:
    maxItems: 1

  interrupts:
    maxItems: 1
    description: SPI may be listed for reporting the address error

patternProperties:
  '(in|out)-ports':
    $ref: /schemas/graph.yaml#/properties/ports

required:
  - compatible
  - reg
  - clocks
  - clock-names

unevaluatedProperties: false
```

## Documentation/devicetree/bindings/arm/coresight-dynamic-funnel.yaml
```yaml
# SPDX-License-Identifier: GPL-2.0-only
%YAML 1.2
---
$id: http://devicetree.org/schemas/arm/coresight-dynamic-funnel.yaml#
$schema: http://devicetree.org/meta-schemas/core.yaml#

title: ARM Coresight Trace Programmable Funnel device

maintainers:
  - Mike Leach <mike.leach@linaro.org>

allOf:
  - $ref: "coresight.yaml"

# Need a custom select here or 'arm,primecell' will match on lots of nodes
select:
  properties:
    compatible:
      contains:
        enum:
          - arm,coresight-dynamic-funnel
          - arm,coresight-funnel
  required:
    - compatible

properties:
  $nodename:
    pattern: "^funnel(@[0-9a-f]+)$"

  compatible:
    oneOf:
      - items:
          - const: arm,coresight-dynamic-funnel
          - const: arm,primecell
      - items:
          - const: arm,coresight-funnel
          - const: arm,primecell
        deprecated: true

  reg:
    maxItems: 1

  cpu:
    $ref: /schemas/types.yaml#/definitions/phandle

  # size cells and address cells required if trig-conns node present.
  "#size-cells":
    const: 0

  "#address-cells":
    const: 1

patternProperties:
  '(in|out)-ports':
    $ref: /schemas/graph.yaml#/properties/ports

required:
  - compatible
  - reg
  - clocks
  - clock-names

unevaluatedProperties: false
```

## Documentation/devicetree/bindings/arm/coresight-dynamic-replicator.yaml
```yaml
# SPDX-License-Identifier: GPL-2.0-only
%YAML 1.2
---
$id: http://devicetree.org/schemas/arm/coresight-dynamic-replicator.yaml#
$schema: http://devicetree.org/meta-schemas/core.yaml#

title: ARM Coresight Trace Programmable Replicator device

maintainers:
  - Mike Leach <mike.leach@linaro.org>

allOf:
  - $ref: "coresight.yaml"

# Need a custom select here or 'arm,primecell' will match on lots of nodes
select:
  properties:
    compatible:
      contains:
        enum:
          - arm,coresight-dynamic-replicator
  required:
    - compatible

properties:
  $nodename:
    pattern: "^replicator(@[0-9a-f]+)$"

  compatible:
    items:
      - const: arm,coresight-dynamic-replicator
      - const: arm,primecell

  reg:
    maxItems: 1

  qcom,replicator-loses-context:
    type: boolean
    description: >
      Indicates that the replicator will lose register context when AMBA clock
      is removed which is observed in some replicator designs.

patternProperties:
  '(in|out)-ports':
    $ref: /schemas/graph.yaml#/properties/ports

required:
  - compatible
  - reg
  - clocks
  - clock-names

unevaluatedProperties: false
```

## Documentation/devicetree/bindings/arm/coresight-etb10.yaml
```yaml
# SPDX-License-Identifier: GPL-2.0-only
%YAML 1.2
---
$id: http://devicetree.org/schemas/arm/coresight-etb10.yaml#
$schema: http://devicetree.org/meta-schemas/core.yaml#

title: ARM Coresight Embedded Trace Buffer device

maintainers:
  - Mike Leach <mike.leach@linaro.org>

allOf:
  - $ref: "coresight.yaml"

# Need a custom select here or 'arm,primecell' will match on lots of nodes
select:
  properties:
    compatible:
      contains:
        enum:
          - arm,coresight-etb10
  required:
    - compatible

properties:
  $nodename:
    pattern: "^etb(@[0-9a-f]+)$"

  compatible:
    items:
      - const: arm,coresight-etb10
      - const: arm,primecell

  reg:
    maxItems: 1

  interrupts:
    maxItems: 1
    description: SPI may be listed for reporting the address error

patternProperties:
  '(in|out)-ports':
    $ref: /schemas/graph.yaml#/properties/ports

required:
  - compatible
  - reg
  - clocks
  - clock-names

unevaluatedProperties: false
```

## Documentation/devicetree/bindings/arm/coresight-etm.yaml
```yaml
# SPDX-License-Identifier: GPL-2.0-only
%YAML 1.2
---
$id: http://devicetree.org/schemas/arm/coresight-etm.yaml#
$schema: http://devicetree.org/meta-schemas/core.yaml#

title: ARM Coresight Embedded Trace Macrocell device

description: FIXME TODO

maintainers:
  - Mike Leach <mike.leach@linaro.org>

allOf:
  - $ref: "coresight.yaml"

# Need a custom select here or 'arm,primecell' will match on lots of nodes
select:
  properties:
    compatible:
      contains:
        enum:
          - arm,coresight-etm
  required:
    - compatible

properties:
  $nodename:
    pattern: "^(e|p)tm(@[0-9a-f]+)$"

  compatible:
    oneOf:
      - items:  # Version 3.x;  Program Flow Trace Macrocell
          - const: arm,coresight-etm3x
          - const: arm,primecell
      - items:  # Version 4.x; with memory mapped access
          - const: arm,coresight-etm4x
          - const: arm,primecell
      - items:  # Version 4.x; with system register access only
          - const: arm,coresight-etm4x-reg
          - const: arm,primecell

  reg:
    maxItems: 1

  cpu:
    $ref: /schemas/types.yaml#/definitions/phandle

  arm,cp14:
    type: boolean
    description: >
      must be present if the system accesses ETM/PTM management
      registers via co-processor 14

  qcom,skip-power-up:
    type: boolean
    description: >
      Indicates that an implementation can
      skip powering up the trace unit. TRCPDCR.PU does not have to be set
      on Qualcomm Technologies Inc. systems since ETMs are in the same power
      domain as their CPU cores. This property is required to identify such
      systems with hardware errata where the CPU watchdog counter is stopped
      when TRCPDCR.PU is set.

patternProperties:
  '(in|out)-ports':
    $ref: /schemas/graph.yaml#/properties/ports

required:
  - compatible
  - reg
  - clocks
  - clock-names

unevaluatedProperties: false
```

## Documentation/devicetree/bindings/arm/coresight-static-replicator.yaml
```yaml
# SPDX-License-Identifier: GPL-2.0-only
%YAML 1.2
---
$id: http://devicetree.org/schemas/arm/coresight-static-replicator.yaml#
$schema: http://devicetree.org/meta-schemas/core.yaml#

title: ARM Coresight Trace Programmable Replicator device

maintainers:
  - Mike Leach <mike.leach@linaro.org>

allOf:
  - $ref: "coresight.yaml"

# Need a custom select here or 'arm,primecell' will match on lots of nodes
select:
  properties:
    compatible:
      contains:
        enum:
          - arm,coresight-static-replicator
  required:
    - compatible

properties:
  $nodename:
    pattern: "^replicator(@[0-9a-f]+)$"

  compatible:
    items:
      - const: arm,coresight-static-replicator
      - const: arm,primecell

  reg:
    maxItems: 1

patternProperties:
  '(in|out)-ports':
    $ref: /schemas/graph.yaml#/properties/ports

required:
  - compatible
  - reg
  - clocks
  - clock-names

unevaluatedProperties: false
```

## Documentation/devicetree/bindings/arm/coresight-stm.yaml
```yaml
# SPDX-License-Identifier: GPL-2.0-only
%YAML 1.2
---
$id: http://devicetree.org/schemas/arm/coresight-stm.yaml#
$schema: http://devicetree.org/meta-schemas/core.yaml#

title: ARM Coresight System Trace Macrocell device

maintainers:
  - Mike Leach <mike.leach@linaro.org>

allOf:
  - $ref: "coresight.yaml"

# Need a custom select here or 'arm,primecell' will match on lots of nodes
select:
  properties:
    compatible:
      contains:
        enum:
          - arm,coresight-stm
  required:
    - compatible

properties:
  $nodename:
    pattern: "^stm(@[0-9a-f]+)$"

  compatible:
    items:
      - const: arm,coresight-stm
      - const: arm,primecell

  clocks:
    maxItems: 1

  clock-names:
    items:
      - const: apb_pclk

  reg:
    minItems: 2
    maxItems: 2

  reg-names:
    items:
      - const: stm-base
      - const: stm-stimulus-base

patternProperties:
  '(in|out)-ports':
    $ref: /schemas/graph.yaml#/properties/ports

required:
  - compatible
  - reg
  - reg-names
  - clocks
  - clock-names

unevaluatedProperties: false
```

## Documentation/devicetree/bindings/arm/coresight-tmc.yaml
```yaml
# SPDX-License-Identifier: GPL-2.0-only
%YAML 1.2
---
$id: http://devicetree.org/schemas/arm/coresight-tmc.yaml#
$schema: http://devicetree.org/meta-schemas/core.yaml#

title: ARM Coresight Trace Memory Controller device

description: >
  Used for Embedded Trace Buffer(ETB), Embedded Trace FIFO(ETF)
  and Embedded Trace Router(ETR) configuration.
  The configuration mode (ETB, ETF, ETR) is discovered at boot time
  when the device is probed.

maintainers:
  - Mike Leach <mike.leach@linaro.org>

allOf:
  - $ref: "coresight.yaml"

# Need a custom select here or 'arm,primecell' will match on lots of nodes
select:
  properties:
    compatible:
      contains:
        enum:
          - arm,coresight-tmc
  required:
    - compatible

properties:
  $nodename:
    pattern: "^(etb|etf|etr)(@[0-9a-f]+)$"

  compatible:
    items:
      - const: arm,coresight-tmc
      - const: arm,primecell

  reg:
    maxItems: 1

  arm,buffer-size:
    $ref: /schemas/types.yaml#/definitions/uint32
    deprecated: true
    description: >
      Contiguous buffer space for TMC ETR (embedded trace router).
      The buffer size can be configured dynamically via buffer_size property in sysfs.

  arm,scatter-gather:
    type: boolean
    description: >
       Indicates that the TMC-ETR can safely use the SG mode on this system.

  arm,max-burst-size:
    $ref: /schemas/types.yaml#/definitions/uint32
    description: >
      The maximum burst size initiated by TMC on the
      AXI master interface. The burst size can be in the range [0..15],
      the setting supports one data transfer per burst up to a maximum of
      16 data transfers per burst.

patternProperties:
  '(in|out)-ports':
    $ref: /schemas/graph.yaml#/properties/ports

required:
  - compatible
  - reg
  - clocks
  - clock-names

unevaluatedProperties: false
```

## Documentation/devicetree/bindings/arm/coresight-tpiu.yaml
```yaml
# SPDX-License-Identifier: GPL-2.0-only
%YAML 1.2
---
$id: http://devicetree.org/schemas/arm/coresight-tpiu.yaml#
$schema: http://devicetree.org/meta-schemas/core.yaml#

title: ARM Coresight Port interface Unit device

maintainers:
  - Mike Leach <mike.leach@linaro.org>

allOf:
  - $ref: "coresight.yaml"

# Need a custom select here or 'arm,primecell' will match on lots of nodes
select:
  properties:
    compatible:
      contains:
        enum:
          - arm,coresight-tpiu
  required:
    - compatible

properties:
  $nodename:
    pattern: "^tpiu(@[0-9a-f]+)$"

  compatible:
    items:
      - const: arm,coresight-tpiu
      - const: arm,primecell

  reg:
    maxItems: 1

  cpu:
    $ref: /schemas/types.yaml#/definitions/phandle

patternProperties:
  '(in|out)-ports':
    $ref: /schemas/graph.yaml#/properties/ports

required:
  - compatible
  - reg

unevaluatedProperties: false
```

## Documentation/devicetree/bindings/display/panel/innolux,td4328.yaml
```yaml
# SPDX-License-Identifier: GPL-2.0
%YAML 1.2
---
$id: http://devicetree.org/schemas/display/panel/innolux,td4328.yaml#
$schema: http://devicetree.org/meta-schemas/core.yaml#

title: Synaptics TD4328 based DSI display Panels

maintainers:
  - Teguh Sobirin <teguh@sobir.in>

description: |
  The TD4328 IC from Synaptics is a DSI Panel IC used to drive DSI panels.

allOf:
  - $ref: panel-common.yaml#

properties:
  compatible:
    const: innolux,td4328
    description: This indicates the panel manufacturer of the panel that is
      in turn using the TD4328 panel driver.

  reset-gpios:
    maxItems: 1
    description: phandle of gpio for reset line - This should be 8mA, gpio
      can be configured using mux, pinctrl, pinctrl-names (active high)

  vddio-supply:
    description: phandle of the regulator that provides the supply voltage
      Power IC supply

  vddpos-supply:
    description: phandle of the positive boost supply regulator

  vddneg-supply:
    description: phandle of the negative boost supply regulator

  rotation:
    description: Display rotation in degrees counter clockwise (0,90,180,270)

  reg: true
  port: true

required:
  - compatible
  - reg
  - vddio-supply
  - vddpos-supply
  - vddneg-supply
  - reset-gpios
  - rotation
  - port

unevaluatedProperties: false

examples:
  - |+
    #include <dt-bindings/gpio/gpio.h>

    dsi0 {
        #address-cells = <1>;
        #size-cells = <0>;

        panel@0 {
            compatible = "innolux,td4328";
            reg = <0>;
            vddio-supply = <&vreg_l14a_1p88>;
            vddpos-supply = <&lab>;
            vddneg-supply = <&ibb>;

            reset-gpios = <&tlmm 6 GPIO_ACTIVE_HIGH>;
            rotation = <90>;

            port {
                panel0_in: endpoint {
                    remote-endpoint = <&dsi0_out>;
                };
            };
        };
    };

...
```
