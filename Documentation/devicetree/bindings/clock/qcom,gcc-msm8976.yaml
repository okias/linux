## Documentation/devicetree/bindings/clock/qcom,gcc-msm8976.yaml
```yaml
# SPDX-License-Identifier: (GPL-2.0-only OR BSD-2-Clause)
%YAML 1.2
---
$id: http://devicetree.org/schemas/clock/qcom,gcc-msm8976.yaml#
$schema: http://devicetree.org/meta-schemas/core.yaml#

title: Qualcomm Global Clock & Reset Controller on MSM8952 and MSM8976

maintainers:
  - Stephen Boyd <sboyd@kernel.org>
  - Taniya Das <quic_tdas@quicinc.com>

description: |
  Qualcomm global clock control module provides the clocks, resets and power
  domains on MSM8952 and MSM8976.

  See also: include/dt-bindings/clock/qcom,gcc-msm8976.h

properties:
  compatible:
    enum:
      - qcom,gcc-msm8952
      - qcom,gcc-msm8976
      - qcom,gcc-msm8976-v1.1

  clocks:
    minItems: 4
    items:
      - description: XO source
      - description: Always-on XO source
      - description: Pixel clock from DSI PHY0
      - description: Byte clock from DSI PHY0
      - description: Pixel clock from DSI PHY1
      - description: Byte clock from DSI PHY1

  clock-names:
    minItems: 4
    items:
      - const: xo
      - const: xo_a
      - const: dsi0pll
      - const: dsi0pllbyte
      - const: dsi1pll
      - const: dsi1pllbyte

  vdd_gfx-supply:
    description:
      Phandle to voltage regulator providing power to the GX domain.

required:
  - compatible
  - clocks
  - clock-names
  - '#power-domain-cells'

allOf:
  - $ref: qcom,gcc.yaml#

  # MSM8952 has a single DSI instance and no GX power domain described
  - if:
      properties:
        compatible:
          not:
            contains:
              const: qcom,gcc-msm8952
    then:
      properties:
        clocks:
          minItems: 6
        clock-names:
          minItems: 6
      required:
        - vdd_gfx-supply

unevaluatedProperties: false

examples:
  - |
    clock-controller@1800000 {
      compatible = "qcom,gcc-msm8976";
      #clock-cells = <1>;
      #reset-cells = <1>;
      #power-domain-cells = <1>;
      reg = <0x1800000 0x80000>;

      clocks = <&xo_board>,
               <&xo_board>,
               <&dsi0_phy 1>,
               <&dsi0_phy 0>,
               <&dsi1_phy 1>,
               <&dsi1_phy 0>;

      clock-names = "xo",
                    "xo_a",
                    "dsi0pll",
                    "dsi0pllbyte",
                    "dsi1pll",
                    "dsi1pllbyte";

      vdd_gfx-supply = <&pm8004_s5>;
    };
...
```

## Documentation/devicetree/bindings/display/panel/motorola,athene-panel.yaml
```yaml
# SPDX-License-Identifier: (GPL-2.0-only OR BSD-2-Clause)
%YAML 1.2
---
$id: http://devicetree.org/schemas/display/panel/motorola,athene-panel.yaml#
$schema: http://devicetree.org/meta-schemas/core.yaml#

title: Motorola Moto G4 Plus (athene) DSI Display Panel

maintainers:
  - David Heidelberg <david@ixit.cz>

description:
  Motorola Moto G4 Plus ships with either an LG Display or a BOE 5.46"
  1080x1920 DSI command mode panel. Both are driven with the same
  initialization sequence and differ only in the default brightness level,
  so a single compatible based on the board name "athene" is used.

allOf:
  - $ref: panel-common.yaml#

properties:
  compatible:
    const: motorola,athene-panel

  reg:
    maxItems: 1

  vddio-supply:
    description: Regulator for the 1.8V IO supply.

  vsp-supply:
    description: Regulator for the positive panel supply.

  vsn-supply:
    description: Regulator for the negative panel supply.

  backlight: true
  port: true
  reset-gpios: true

required:
  - compatible
  - reg
  - vddio-supply
  - vsp-supply
  - vsn-supply
  - port

additionalProperties: false

examples:
  - |
    #include <dt-bindings/gpio/gpio.h>

    dsi {
        #address-cells = <1>;
        #size-cells = <0>;

        panel@0 {
            compatible = "motorola,athene-panel";
            reg = <0>;

            reset-gpios = <&tlmm 0 GPIO_ACTIVE_LOW>;

            vddio-supply = <&pm8950_l6>;
            vsp-supply = <&lab>;
            vsn-supply = <&ibb>;

            backlight = <&backlight>;

            port {
                panel_in: endpoint {
                    remote-endpoint = <&mdss_dsi0_out>;
                };
            };
        };
    };
...
```

## Documentation/devicetree/bindings/input/qcom,pmi8998-haptics.yaml
```yaml
# SPDX-License-Identifier: (GPL-2.0-only OR BSD-2-Clause)
# Copyright 2020 Unisoc Inc.
%YAML 1.2
---
$id: http://devicetree.org/schemas/input/qcom,pmi8998-haptics.yaml#
$schema: http://devicetree.org/meta-schemas/core.yaml#

title: Qualcomm PMI8998/PM660 Haptics

maintainers:
  - Casey Connolly <casey@connolly.tech>

description: |
  Qualcomm SPMI haptics is a peripheral on some QTI PMICs. It supports linear resonant
  actuators and eccentric rotating mass type haptics commonly found in mobile devices.
  It supports multiple sources of wave data such as an internal buffer, direct play
  (from kernel or userspace) as well as an audio output mode.

properties:
  compatible:
    items:
      - enum:
          - qcom,pmi8998-haptics
          - qcom,pm660-charger
          - qcom,pmi8996-haptics
          - qcom,pmi8941-haptics

  reg:
    maxItems: 1

  interrupts:
    maxItems: 2

  interrupt-names:
    items:
      - const: short
      - const: play

  qcom,wave-play-rate-us:
    description: |
      Wave sample durection in microseconds, 1/f where f
      is the resonant frequency of the actuator.
    $ref: /schemas/types.yaml#/definitions/uint32
    minimum: 0
    maximum: 20475

required:
  - compatible
  - reg
  - interrupts
  - qcom,wave-play-rate-us

additionalProperties: false

examples:
  - |
      #include <dt-bindings/interrupt-controller/irq.h>

      spmi {
        #address-cells = <1>;
        #size-cells = <0>;
        pmi8998_haptics: haptics@c000 {
          compatible = "qcom,pmi8998-haptics";
          reg = <0xc000>;

          interrupts = <0x3 0xc0 0x0 IRQ_TYPE_EDGE_BOTH>,
                      <0x3 0xc0 0x1 IRQ_TYPE_EDGE_BOTH>;
          interrupt-names = "short", "play";

          qcom,wave-play-rate-us = <4255>;
        };
      };
```
