## Documentation/devicetree/bindings/display/rockchip/rockchip,dw-mipi-dsi.yaml
```yaml
# SPDX-License-Identifier: (GPL-2.0-only OR BSD-2-Clause)
%YAML 1.2
---
$id: http://devicetree.org/schemas/display/rockchip/rockchip,dw-mipi-dsi.yaml#
$schema: http://devicetree.org/meta-schemas/core.yaml#

title: Rockchip specific extensions to the Synopsys Designware MIPI DSI

maintainers:
  - opensource@rock-chips.com

allOf:
  - if:
      properties:
        compatible:
          contains:
            const: rockchip,px30-mipi-dsi
      then:
        properties:
          clocks:
            maxItems: 1
          clock-names:
            items:
              - const: pclk

  - if:
      properties:
        compatible:
          contains:
            const: rockchip,rk3288-mipi-dsi
      then:
        properties:
          clocks:
            maxItems: 2
          clock-names:
            items:
              - const: ref
              - const: pclk

  - if:
      properties:
        compatible:
          contains:
            const: rockchip,rk3399-mipi-dsi
      then:
        properties:
          clocks:
            minItems: 4
            maxItems: 4
          clock-names:
            items:
              - const: ref
              - const: pclk
              - const: phy_cfg
              - const: grf

properties:
  compatible:
    oneOf:
      - items:
          - enum:
              - rockchip,px30-mipi-dsi
              - rockchip,rk3288-mipi-dsi
              - rockchip,rk3399-mipi-dsi
          - const: snps,dw-mipi-dsi

  reg:
    maxItems: 1

  interrupts:
    maxItems: 1

  clocks: true

  clock-names: true

  phys:
    maxItems: 1
    description: Optional external PHY

  phy-names:
    const: dphy

  ports:
    $ref: /schemas/graph.yaml#/properties/ports

    properties:
      port@0:
        $ref: /schemas/graph.yaml#/$defs/port-base
        unevaluatedProperties: false
        description: >
          Video port for the VOP input.

        properties:
          endpoint@0:
            $ref: /schemas/graph.yaml#/properties/endpoint
            description: Connection to the VOPB

          endpoint@1:
            $ref: /schemas/graph.yaml#/properties/endpoint
            description: Connection to the VOPL

        required:
          - endpoint@0

      port@1:
        $ref: /schemas/graph.yaml#/properties/port
        description: >
          Video port for panel or subsequent encoder

    required:
      - port@0
      - port@1

  resets:
    maxItems: 1

  reset-names:
    items:
      - const: apb

  rockchip,grf:
    $ref: /schemas/types.yaml#/definitions/phandle
    description:
      phandle to the GRF to mux vopl/vopb

  power-domains: true

  '#address-cells':
    const: 1

  '#phy-cells':
    const: 0

  '#size-cells':
    const: 0

required:
  - compatible
  - reg
  - clocks
  - rockchip,grf
  - ports
  - '#address-cells'
  - '#size-cells'

additionalProperties: true

examples:
  - |
    #include <dt-bindings/clock/rk3288-cru.h>

    mipi_dsi: mipi@ff960000 {
        #address-cells = <1>;
        #size-cells = <0>;
        compatible = "rockchip,rk3288-mipi-dsi", "snps,dw-mipi-dsi";
        reg = <0xff960000 0x4000>;
        interrupts = <0 83 4>;
        clocks = <&cru 148>, <&cru PCLK_MIPI_DSI0>;
        clock-names = "ref", "pclk";
        resets = <&cru SRST_MIPIDSI0>;
        reset-names = "apb";
        rockchip,grf = <&grf>;

        ports {
            #address-cells = <1>;
            #size-cells = <0>;

            mipi_in: port@0 {
                reg = <0>;
                #address-cells = <1>;
                #size-cells = <0>;

                mipi_in_vopb: endpoint@0 {
                    reg = <0>;
                    remote-endpoint = <&vopb_out_mipi>;
                };
                mipi_in_vopl: endpoint@1 {
                    reg = <1>;
                    remote-endpoint = <&vopl_out_mipi>;
                };
            };

            mipi_out: port@1 {
                reg = <1>;
                #address-cells = <1>;
                #size-cells = <0>;

                mipi_out_panel: endpoint {
                    remote-endpoint = <&panel_in_mipi>;
                };
            };
        };
    };
```

## Documentation/devicetree/bindings/i2c/i2c-qcom-cci.yaml
```yaml
# SPDX-License-Identifier: (GPL-2.0-only OR BSD-2-Clause)
%YAML 1.2
---
$id: http://devicetree.org/schemas/i2c/i2c-qcom-cci.yaml#
$schema: http://devicetree.org/meta-schemas/core.yaml#

title: Qualcomm Camera Control Interface (CCI) I2C controller

maintainers:
  - Rob Herring <robh+dt@kernel.org>

properties:
  compatible:
    enum:
      - qcom,msm8916-cci
      - qcom,msm8996-cci
      - qcom,sdm845-cci
      - qcom,sm8250-cci

  reg:
    maxItems: 1

  interrupts:
    maxItems: 1

  clocks:
    minItems: 4
    maxItems: 6

  clock-names:
    oneOf:
      - items:
          - const: camss_top_ahb
          - const: cci_ahb
          - const: cci
          - const: camss_ahb
      - items: # SDM845
          - const: camnoc_axi
          - const: soc_ahb
          - const: slow_ahb_src
          - const: cpas_ahb
          - const: cci
          - const: cci_src

  power-domains: true

  '#address-cells':
    const: 1

  '#size-cells':
    const: 0

allOf:
  - if:
      properties:
        compatible:
          contains:
            const: qcom,msm8996-cci
    then:
      required:
        - power-domains

patternProperties:
  "^i2c-bus@[01]$":
    type: object
    description: >
      The CCI provides I2C masters for one (msm8916) or two i2c busses (msm8996, sdm845 and sm8250).
    properties:
      reg:
        maxItems: 1

      clock-frequency:
        default: 100000

      '#address-cells':
        const: 1

      '#size-cells':
        const: 0

    patternProperties:
      "^camera([-_]rear)?@[0-9a-f]+$":
        type: object
        description: The camera i2c node.

    additionalProperties: false

additionalProperties: false

required:
  - compatible
  - reg
  - interrupts
  - clocks
  - clock-names
  - '#address-cells'
  - '#size-cells'

examples:
  - |
    cci@a0c000 {
        compatible = "qcom,msm8996-cci";
        #address-cells = <1>;
        #size-cells = <0>;
        reg = <0xa0c000 0x1000>;
        interrupts = <0 295 1>;
        clocks = <&mmcc 63>,
             <&mmcc 78>,
             <&mmcc 33>,
             <&mmcc 123>,
             <&mmcc 76>;
        clock-names = "camss_top_ahb",
                      "cci_ahb",
                      "cci",
                      "camss_ahb";

        power-domains = <&mmcc 87>;

        i2c-bus@0 {
            reg = <0>;
            clock-frequency = <400000>;
            #address-cells = <1>;
            #size-cells = <0>;
        };

        i2c-bus@1 {
            reg = <1>;
            clock-frequency = <400000>;
            #address-cells = <1>;
            #size-cells = <0>;
        };
    };
```

## Documentation/devicetree/bindings/input/touchscreen/focaltech,fts.yaml
```yaml
# SPDX-License-Identifier: (GPL-2.0-only OR BSD-2-Clause)
%YAML 1.2
---
$id: http://devicetree.org/schemas/input/touchscreen/focaltech,fts.yaml#
$schema: http://devicetree.org/meta-schemas/core.yaml#

title: Focaltech FTS I2C Touchscreen Controller

maintainers:
  - Caleb Connolly <caleb@connolly.tech>
  - Joel Selvaraj <jo@jsfamily.in>

allOf:
  - $ref: touchscreen.yaml#

properties:
  compatible:
    enum:
      - focaltech,fts5452
      - focaltech,fts8719
  reg:
    const: 0x38

  interrupts:
    maxItems: 1

  reset-gpios:
    maxItems: 1

  focaltech,max-touch-number:
    $ref: /schemas/types.yaml#/definitions/uint32
    description: max number of fingers supported
    minimum: 2
    maximum: 10

  touchscreen-size-x: true
  touchscreen-size-y: true

additionalProperties: false

required:
  - compatible
  - reg
  - reset-gpios
  - focaltech,max-touch-number
  - touchscreen-size-x
  - touchscreen-size-y

examples:
  - |
    #include <dt-bindings/interrupt-controller/irq.h>
    #include <dt-bindings/gpio/gpio.h>
    &i2c5 {
      status="okay";

      touchscreen: focaltech@38 {
        compatible = "focaltech,fts8719";
        reg = <0x38>;
        interrupt-parent = <&tlmm>;
        interrupts = <31 IRQ_TYPE_EDGE_FALLING>;

        avdd-supply = <&vreg_l28a_3p0>;
        vddio-supply = <&vreg_l14a_1p8>;

        pinctrl-names = "default", "sleep";
        pinctrl-0 = <&ts_int_default &ts_reset_default>;
        pinctrl-1 = <&ts_int_sleep &ts_reset_sleep>;

        reset-gpio = <&tlmm 32 GPIO_ACTIVE_LOW>;

        touchscreen-size-x = <1080>;
        touchscreen-size-y = <2246>;
        focaltech,max-touch-number = <10>;
      };
    };
```

## Documentation/devicetree/bindings/media/i2c/rohm,bu64748.yaml
```yaml
# SPDX-License-Identifier: (GPL-2.0 OR BSD-2-Clause)
# Copyright 2025 Joel Selvaraj <foss@joelselvaraj.com>
%YAML 1.2
---
$id: http://devicetree.org/schemas/media/i2c/rohm,bu64748.yaml##
$schema: http://devicetree.org/meta-schemas/core.yaml#

title: ROHM BU64748 Voice Coil Motor (VCM) Lens

maintainers:
  - Joel Selvaraj <foss@joelselvaraj.com>

description:
  The BU64748 is a 12-bit digital-to-analog (DAC) converter.
  VCM current is controlled with linear mode driver. The DAC is controlled
  via 2-wire (I2C-compatible) serial interface. This chip is intended for
  driving voice coil lenses in camera modules.

properties:
  compatible:
    enum:
      - rohm,bu64748

  reg:
    maxItems: 1

  vcc-supply:
    description:
      VCM power supply.

  vio-supply:
    description:
      I/O power supply of the CCI i2c interface.

required:
  - compatible
  - reg
  - vcc-supply

additionalProperties: false

examples:
  - |

    i2c {
        #address-cells = <1>;
        #size-cells = <0>;

        camera-lens@c {
            compatible = "rohm,bu64748";
            reg = <0x0c>;

            vcc-supply = <&cam_actuator_reg>;
            vio-supply = <&cam_iovdd>;
        };
    };
...
```

## Documentation/devicetree/bindings/mfd/qcom,spmi-pmic.yaml
```yaml
# SPDX-License-Identifier: GPL-2.0-only
%YAML 1.2
---
$id: http://devicetree.org/schemas/mfd/qcom,spmi-pmic.yaml#
$schema: http://devicetree.org/meta-schemas/core.yaml#

title: Qualcomm SPMI PMICs multi-function device

description: |
  Some Qualcomm PMICs used with the Snapdragon series SoCs are interfaced
  to the chip via the SPMI (System Power Management Interface) bus.
  Support for multiple independent functions are implemented by splitting the
  16-bit SPMI peripheral address space into 256 smaller fixed-size regions, 256 bytes
  each. A function can consume one or more of these fixed-size register regions.

  The Qualcomm SPMI series includes the PM8941, PM8841, PMA8084, PM8998 and other
  PMICs.  These PMICs use a "QPNP" scheme through SPMI interface.
  QPNP is effectively a partitioning scheme for dividing the SPMI extended
  register space up into logical pieces, and set of fixed register
  locations/definitions within these regions, with some of these regions
  specifically used for interrupt handling.

maintainers:
  - Stephen Boyd <sboyd@kernel.org>

properties:
  $nodename:
    oneOf:
      - pattern: '^pmic@.*$'
      - pattern: '^pm(a|s)?[0-9]*@.*$'
        deprecated: true

  compatible:
    items:
      - enum:
          - qcom,pm660
          - qcom,pm660l
          - qcom,pm6150
          - qcom,pm6150l
          - qcom,pm6350
          - qcom,pm7325
          - qcom,pm8004
          - qcom,pm8005
          - qcom,pm8009
          - qcom,pm8019
          - qcom,pm8110
          - qcom,pm8150
          - qcom,pm8150b
          - qcom,pm8150l
          - qcom,pm8226
          - qcom,pm8350
          - qcom,pm8350b
          - qcom,pm8350c
          - qcom,pm8841
          - qcom,pm8909
          - qcom,pm8916
          - qcom,pm8941
          - qcom,pm8950
          - qcom,pm8994
          - qcom,pm8998
          - qcom,pma8084
          - qcom,pmd9635
          - qcom,pmi8950
          - qcom,pmi8962
          - qcom,pmi8994
          - qcom,pmi8998
          - qcom,pmk8350
          - qcom,pmm8155au
          - qcom,pmr735a
          - qcom,pmr735b
          - qcom,pms405
          - qcom,pmx55
          - qcom,smb2351
      - const: qcom,spmi-pmic

  reg: true

  "#address-cells":
    const: 1

  "#size-cells":
    const: 0


patternProperties:
  '^(labibb|([a-z][a-z0-9]+-)?regulators)$':
    type: object

    required:
      - compatible

  '@[0-9a-f]+$':
    type: object
    description: >
      Each child node of the PMIC represents a function of it.

    properties:
      reg: true

      interrupts:
        description: >
          Interrupts are specified as a 4-tuple. For more information see
          Documentation/devicetree/bindings/spmi/qcom,spmi-pmic-arb.yaml

    required:
      - compatible

    additionalProperties: true

required:
  - compatible
  - reg

additionalProperties: false

examples:
  - |
    #include <dt-bindings/spmi/spmi.h>
    #include <dt-bindings/interrupt-controller/irq.h>
    #include <dt-bindings/interrupt-controller/arm-gic.h>

    spmi@c440000 {
        compatible = "qcom,spmi-pmic-arb";
        reg = <0x0c440000 0x1100>,
              <0x0c600000 0x2000000>,
              <0x0e600000 0x100000>,
              <0x0e700000 0xa0000>,
              <0x0c40a000 0x26000>;
        reg-names = "core", "chnls", "obsrvr", "intr", "cnfg";
        interrupt-names = "periph_irq";
        interrupts = <GIC_SPI 481 IRQ_TYPE_LEVEL_HIGH>;
        qcom,ee = <0>;
        qcom,channel = <0>;
        #address-cells = <2>;
        #size-cells = <0>;
        interrupt-controller;
        #interrupt-cells = <4>;
        cell-index = <0>;

        pmi8998_lsid0: pmic@2 {
            compatible = "qcom,pmi8998", "qcom,spmi-pmic";
            reg = <0x2 SPMI_USID>;
            #address-cells = <1>;
            #size-cells = <0>;

            pmi8998_gpio: gpios@c000 {
                compatible = "qcom,pmi8998-gpio", "qcom,spmi-gpio";
                reg = <0xc000>;
                gpio-controller;
                gpio-ranges = <&pmi8998_gpio 0 0 14>;
                #gpio-cells = <2>;
                interrupt-controller;
                #interrupt-cells = <2>;
            };
        };
    };
```
